## main/Kconfig
```kconfig
menu "Joylink"
config JOYLINK_ENABLE
	bool "Enabe Joylink"
	default y

config JOYLINK_SMNT_BUTTON_NUM
    int "the io number for smnt configure network"
    default 14
	depends on JOYLINK_ENABLE
    
config JOYLINK_RESET_BUTTON_NUM
    int "the io number for reset"
    default 15
	depends on JOYLINK_ENABLE

config JOYLINK_SOFTAP_BUTTON_NUM
    int "the io number for softap configure network"
    default 16
	depends on JOYLINK_ENABLE
config JOYLINK_DEVICE_UUID
    string "The device uuid, you can get it from Joylink"
        depends on JOYLINK_ENABLE

config JOYLINK_SMNT_AES_KEY
    string "The secret key for smnt, you can get it from Joylink"
        depends on JOYLINK_ENABLE

config JOYLINK_PUBLIC_KEY
    string "The public key, you can get it from Joylink"
        depends on JOYLINK_ENABLE

config JOYLINK_SOFTAP_ENABLE
    bool "Enabe Joylink softap configure wifi"
	default y
	depends on JOYLINK_ENABLE

config JOYLINK_SOFTAP_PACKET_HEAD
    string "The public key, you can get it from Joylink"
        depends on JOYLINK_SOFTAP_ENABLE

config JOYLINK_DEVICE_BRAND
    string "The public key, you can get it from Joylink"
        depends on JOYLINK_SOFTAP_ENABLE
	
config JOYLINK_DEVICE_CID
    string "The public key, you can get it from Joylink"
        depends on JOYLINK_SOFTAP_ENABLE


endmenu
```

## products/joylink_demo/Kconfig
```kconfig
menu "Joylink"
config JOYLINK_ENABLE
	bool "Enabe Joylink"
	default y

config JOYLINK_SMNT_BUTTON_NUM
    int "the io number for configure network"
    default 14
	depends on JOYLINK_ENABLE
    
config JOYLINK_RESET_BUTTON_NUM
    int "the io number for reset"
    default 15
	depends on JOYLINK_ENABLE

config JOYLINK_DEVICE_UUID
    string "The device uuid, you can get it from Joylink"
        depends on JOYLINK_ENABLE

config JOYLINK_SMNT_AES_KEY
    string "The secret key for smnt, you can get it from Joylink"
        depends on JOYLINK_ENABLE

config JOYLINK_PUBLIC_KEY
    string "The public key, you can get it from Joylink"
        depends on JOYLINK_ENABLE

endmenu
```

## sdkconfig.defaults
```kconfig
#
# Partition Table
#
# CONFIG_PARTITION_TABLE_SINGLE_APP is not set
CONFIG_PARTITION_TABLE_CUSTOM=y
CONFIG_PARTITION_TABLE_CUSTOM_FILENAME="partitions_jd.csv"
CONFIG_PARTITION_TABLE_CUSTOM_APP_BIN_OFFSET=0x100000
CONFIG_PARTITION_TABLE_FILENAME="partitions_jd.csv"
CONFIG_APP_OFFSET=0x100000

#
# Component config
#
CONFIG_BT_ENABLED=y
CONFIG_BTC_TASK_STACK_SIZE=3072
# CONFIG_BLUEDROID_MEM_DEBUG is not set
CONFIG_BT_DRAM_RELEASE=y
CONFIG_GATTS_ENABLE=y
# CONFIG_GATTC_ENABLE is not set
# CONFIG_SMP_ENABLE is not set
CONFIG_BT_RESERVE_DRAM=0x10000

#
# LWIP
#
# CONFIG_L2_TO_L3_COPY is not set
CONFIG_LWIP_SO_REUSE=y
CONFIG_LWIP_SO_RCVBUF=y


#
# FreeRTOS
#
CONFIG_FREERTOS_UNICORE=y

#
# PHY
#
CONFIG_ESP32_PHY_INIT_DATA_IN_PARTITION=y



CONFIG_JOYLINK_DEVICE_UUID="CF1484"
CONFIG_JOYLINK_SMNT_AES_KEY="K8AG43A6M4BN6PAG"
CONFIG_JOYLINK_PUBLIC_KEY="03D5A54ACF235E77FC1240754DB26BC0E20949E5A3C68338A635CA646EC336D1D9"
JOYLINK_SOFTAP_ENABLE=y
CONFIG_JOYLINK_SOFTAP_PACKET_HEAD="JYAP"
CONFIG_JOYLINK_DEVICE_BRAND="0024"
CONFIG_JOYLINK_DEVICE_CID="0226"
```
